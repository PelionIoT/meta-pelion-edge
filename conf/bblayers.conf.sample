## conf/bblayers.conf.sample
```bitbake
# POKY_BBLAYERS_CONF_VERSION is increased each time build/conf/bblayers.conf
# changes incompatibly
POKY_BBLAYERS_CONF_VERSION = "3"

OEROOT := "${@os.path.abspath(os.path.dirname(d.getVar('FILE', True)))}/../.."

BBPATH = "${TOPDIR}"
BBFILES ?= ""

BBLAYERS ?= " \
    ##OEROOT##/meta-pelion-edge \
    ##OEROOT##/meta \
    ##OEROOT##/meta-poky \
    ##OEROOT##/meta-openembedded/meta-oe \
    ##OEROOT##/meta-openembedded/meta-filesystems \
    ##OEROOT##/meta-openembedded/meta-networking \
    ##OEROOT##/meta-openembedded/meta-perl \
    ##OEROOT##/meta-openembedded/meta-python \
    ##OEROOT##/meta-virtualization \
    ##OEROOT##/meta-raspberrypi \
    ##OEROOT##/meta-security \
    ##OEROOT##/meta-nodejs \
"
```

## conf/layer.conf
```bitbake
# We have a conf and classes directory, append to BBPATH
BBPATH .= ":${LAYERDIR}"

# We have a recipes directory, add to BBFILES
BBFILES += "${LAYERDIR}/recipes*/*/*.bb ${LAYERDIR}/recipes*/*/*.bbappend ${LAYERDIR}/images/*.bb"

BBFILE_COLLECTIONS += "meta-edge"
BBFILE_PATTERN_meta-edge := "^${LAYERDIR}/"
BBFILE_PRIORITY_meta-edge = "16"

LAYERSERIES_COMPAT_meta-edge = "dunfell gatesgarth hardknott"
```

## conf/local.conf.sample
```bitbake
# Local configuration for meta-rpi images
# Yocto Project 2.6 Poky distribution [thud] branch
# This is a sysvinit system

RPI_USE_U_BOOT = "1"

# to take a better look at the u-boot startup messages,
# uncomment these lines to disable the normal boot logo/splash
#DISABLE_RPI_BOOT_LOGO = "1"
#IMAGE_FEATURES_remove = "splash"

DISTRO_FEATURES = "ext2 opengl usbhost ${DISTRO_FEATURES_LIBC} virtualization k8s"

DISTRO_FEATURES_BACKFILL_CONSIDERED += "pulseaudio"

PREFERRED_PROVIDER_jpeg = "libjpeg-turbo"
PREFERRED_PROVIDER_jpeg-native = "libjpeg-turbo-native"

PREFERRED_PROVIDER_udev = "eudev"

DISTRO_FEATURES_append = " systemd"
VIRTUAL-RUNTIME_init_manager = "systemd" 
VIRTUAL-RUNTIME_initscripts = "systemd-compat-units"
DISTRO_FEATURES_BACKFILL_CONSIDERED = "sysvinit"

MACHINE_FEATURES_remove = "apm"

WKS_FILE = "console-image.wic"
IMAGE_FSTYPES = "${INITRAMFS_FSTYPES} wic wic.gz wic.bmap"

DISTRO_FEATURES_append += " bluez5 bluetooth wifi"

# Choose the board you are building for
#MACHINE="raspberrypi"
#MACHINE="raspberrypi0"
#MACHINE="raspberrypi0-wifi"
#MACHINE="raspberrypi2"
MACHINE = "raspberrypi3"
#MACHINE="raspberrypi-cm"
#MACHINE="raspberrypi-cm3"

# Choices are Image or zImage if NOT using u-boot (no u-boot is the default)
# Choices are uImage or zImage if using u-boot, though if you choose zImage
# with u-boot you will also have to change the boot script boot command
# Not specifying a type here will fall back to u-boot selecting an image type.
#KERNEL_IMAGETYPE = "zImage"

DISABLE_OVERSCAN = "1"
ENABLE_UART = "1"

# If you need serial console access, for example to debug uboot or
# initramfs, uncomment the next two lines.  Be aware that doing this
# disables the bluetooth radio, so do not leave this on by default.
#ENABLE_SERIAL_CONSOLE = "1"
#SERIAL_CONSOLES = "115200;ttyAMA0"
# SERIAL_CONSOLES_forcevariable = ""

#DL_DIR = "${HOME}/oe-sources"
#SSTATE_DIR = "/oe4/rpi/sstate-cache"
#TMPDIR = "/oe4/rpi/tmp-thud"

#initramfs setup
INITRAMFS_IMAGE = "ww-console-image-initramfs"
INITRAMFS_IMAGE_BUNDLE = "1"
BOOT_SPACE = "1073741"
INITRAMFS_MAXSIZE = "2600000"


DISTRO = "poky"
PACKAGE_CLASSES = "package_ipk"

# i686 or x86_64
SDKMACHINE = "x86_64"

# for no root passwd uncomment the following and comment the two extra user lines
#EXTRA_IMAGE_FEATURES = "debug-tweaks"

# for a root passwd, change redmbed below to your password
INHERIT += "extrausers"
EXTRA_USERS_PARAMS = "usermod -P redmbed root; "

# this will force root to change password on first login
INHERIT += "chageusers"
CHAGE_USERS_PARAMS = "chage -d0 root; "

PREFERRED_PROVIDER_node-native = "nodejs-native"
PREFERRED_PROVIDER_node = "nodejs"
PREFERRED_VERSION_nodejs = "8.11.2"
PREFERRED_VERSION_nodejs-native = "8.11.2"

# force golang 1.14% compiler
# from poky master branch (newer than dunfell) see file: tcmode-default.inc
GOVERSION = "1.14%"
PREFERRED_PROVIDER_openssl = "openssl10"
PREFERRED_PROVIDER_openssl-native = "openssl10-native"
PREFERRED_VERSION_openssl10 = "1.0.2%"

USER_CLASSES = "image-mklibs image-prelink"
PATCHRESOLVE = "noop"
RM_OLD_IMAGE = "1"
INHERIT += "rm_work"
CONF_VERSION = "1"

export SSH_AUTH_SOCK

DISABLE_VC4GRAPHICS = "1"
```

## meta-imx8mmsolidrun-support/conf/layer.conf
```bitbake
# We might have a conf and classes directory, append to BBPATH
BBPATH .= ":${LAYERDIR}"

# We have a recipes directory, add to BBFILES
BBFILES += "${LAYERDIR}/recipes*/*/*.bb ${LAYERDIR}/recipes*/*/*.bbappend"

BBFILE_COLLECTIONS += "meta-subscriber-overrides"
BBFILE_PATTERN_meta-subscriber-overrides := "^${LAYERDIR}/"
BBFILE_PRIORITY_meta-subscriber-overrides = "10"

LAYERDEPENDS_meta-subscriber-overrides = "meta-lmp-base"
LAYERSERIES_COMPAT_meta-subscriber-overrides = "dunfell gatesgarth hardknott"
```

## meta-imx8mmsolidrun-support/conf/machine/imx8mmsolidrun.conf
```bitbake
#@TYPE: Machine
#@NAME: SolidRun iMX8MM based platforms
#@SOC: i.MX8MM
#@DESCRIPTION: Machine configuration for SolidRun iMX8MM based platforms
#@MAINTAINER: Ricardo Salveti <ricardo@foundries.io>

MACHINEOVERRIDES =. "mx8:mx8m:mx8mm:imx8mm-lpddr4-evk:"

require conf/machine/include/imx-base.inc
require conf/machine/include/tune-cortexa53.inc

IMX_DEFAULT_BSP = "nxp"

MACHINE_FEATURES += "pci wifi bluetooth optee"

UBOOT_MACHINE_imx8mmsolidrun = "imx8mm_solidrun_defconfig"
SPL_BINARY = "spl/u-boot-spl.bin"

ATF_PLATFORM = "imx8mm"
ATF_LOAD_ADDR = "0x920000"

# Set DDR FIRMWARE
DDR_FIRMWARE_NAME = "lpddr4_pmu_train_1d_imem.bin lpddr4_pmu_train_1d_dmem.bin lpddr4_pmu_train_2d_imem.bin lpddr4_pmu_train_2d_dmem.bin"

# Set u-boot DTB
UBOOT_DTB_NAME = "imx8mm-solidrun.dtb"

# Set imx-mkimage boot target
IMXBOOT_TARGETS = "flash_evk"
IMX_BOOT_SOC_TARGET = "iMX8MM"

# Set Serial console
SERIAL_CONSOLES = "115200;ttymxc1"

LOADADDR = ""
UBOOT_SUFFIX = "bin"
UBOOT_MAKE_TARGET = ""
IMX_BOOT_SEEK = "33"

OSTREE_KERNEL_ARGS_imx8mmsolidrun ?= "console=tty1 console=ttymxc1,115200 earlycon=ec_imx6q,0x30890000,115200 root=LABEL=otaroot rootfstype=ext4"

# device tree setup
PREFERRED_PROVIDER_virtual/dtb = "lmp-device-tree"
KERNEL_DEVICETREE_imx8mmsolidrun = ""
# avoid the new DTB added meta-lmp for imx8mm-evk
KERNEL_DEVICETREE_remove_imx8mmsolidrun = " freescale/imx8mm-evkb.dtb"
# Make sure we build the devicetree and add it to lmp-base builds
EXTRA_IMAGEDEPENDS_append = " virtual/dtb "
IMAGE_BOOT_FILES_append_lmp-base = " \
        devicetree/freescale_imx8mm-solidrun.dtb;imx8mm-solidrun.dtb \
"

# Add WiFi/BT firmware
MACHINE_FIRMWARE_append = " \
    linux-firmware-cyw-bt-patch-bcm43455 \
    linux-firmware-cyw-fmac-fw-bcm43455-sdio \
    linux-firmware-cyw-fmac-nvram-bcm43455-sdio \
"

# SolidRun Hummingboard Pulse has a Murata 1MW wifi/bt module which uses custom recipes
# linux-firmware-cyw-fmac-fw, linux-firmware-cyw-fmac-nvram and linux-firmware-cyw-bt-patch.
# Make sure we avoid default linux bcm43455 firmware
CORE_IMAGE_BASE_INSTALL_remove_imx8mmsolidrun = " \
    linux-firmware-bcm43455 \
"
```

## meta-imx8mmsolidrun-support/conf/machine/include/lmp-factory-custom.inc
```bitbake
# LMP factory specific customizations (either replace or extend options as defined by meta-lmp)

# imx8mm solidrun
OSTREE_KERNEL_ARGS_imx8mmsolidrun ?= "console=tty1 console=ttymxc1,115200 earlycon=ec_imx6q,0x30890000,115200 root=LABEL=otaroot rootfstype=ext4"

# device tree setup
PREFERRED_PROVIDER_virtual/dtb_imx8mmsolidrun ?= "lmp-device-tree"
KERNEL_DEVICETREE_imx8mmsolidrun = ""
# Make sure we build the devicetree and add it to lmp-base builds
EXTRA_IMAGEDEPENDS_append_imx8mmsolidrun = " virtual/dtb "
IMAGE_BOOT_FILES_append_lmp-base_imx8mmsolidrun = " \
	devicetree/freescale_imx8mm-solidrun.dtb:imx8mm-solidrun.dtb \
"

# Add additional firmware for Wifi/BT
MACHINE_FIRMWARE_append_imx8mmsolidrun = " \
       linux-firmware-cyw-fmac-fw \
       linux-firmware-cyw-fmac-nvram \
       linux-firmware-cyw-bt-patch \
"
```

## meta-lmp-support/conf/layer.conf
```bitbake
# We have a conf and classes directory, append to BBPATH
BBPATH .= ":${LAYERDIR}"

# We have a recipes directory, add to BBFILES
BBFILES += "${LAYERDIR}/recipes*/*/*.bb ${LAYERDIR}/recipes*/*/*.bbappend ${LAYERDIR}/images/*.bb"

BBFILE_COLLECTIONS += "meta-lmp-support"
BBFILE_PATTERN_meta-lmp-support := "^${LAYERDIR}/"
BBFILE_PRIORITY_meta-lmp-support = "16"

LAYERSERIES_COMPAT_meta-lmp-support = "dunfell gatesgarth hardknott"
```

## meta-lmp-support/conf/machine/include/lmp-factory-custom.inc
```bitbake
#Use ttyAMA0 instead of ttyS0 that is set in meta-lmp
#this can cause problems with bluetooth. config removed
KERNEL_SERIAL_rpi = "${@oe.utils.conditional("ENABLE_UART", "1", "console=ttyAMA0,115200", "", d)}"

#Docker requires cgroup memory
OSTREE_KERNEL_ARGS_COMMON += "cgroup_enable=memory cgroup_memory=1"

#Use sdcard as root device by default
OSTREE_KERNEL_ARGS_imx8mm-lpddr4-evk = "console=tty1 console=ttymxc1,115200 earlycon=ec_imx6q,0x30890000,115200 root=/dev/mmcblk1p2 rootfstype=ext4"

# Disable anything to do with pushing image to server
# (mainly just silences a warning about SOTA_PACKED_CREDENTIALS not being set)
IMAGE_FSTYPES:remove = "ostreepush"
IMAGE_FSTYPES:remove = "garagesign"
IMAGE_FSTYPES:remove = "garagecheck"

# Set defaults for PARSEC_PROVIDER.
# All boards can support the SOFTHSM.
# The mx8 and uz boards could use PKCS11, but not without combined update.
# The rpi can use the SOFTHSM

PARSEC_PROVIDER ?= "SOFTHSM"
PARSEC_PROVIDER_uz ?= "SOFTHSM"
PARSEC_PROVIDER_mx8 ?= "SOFTHSM"
PARSEC_PROVIDER_rpi ?= "SOFTHSM"
```

## wic/console-image.wks
```
# short-description: Create Raspberry Pi SD card image
# long-description: Creates a partitioned SD card image for use with
# Raspberry Pi. Boot files are located in the first vfat partition.

part /mnt/.boot --source bootimg-partition --ondisk mmcblk0 --fstype=vfat --label boot --active --align 4096 --fixed-size 128
part /mnt/.overlay/factory --source rootfs --ondisk mmcblk0 --fstype=ext4 --label factory --align 4096 --size 2048
part /mnt/.overlay/upgrade --ondisk mmcblk0 --fstype=ext4 --label upgrade --size 2048
part /mnt/.overlay/user --ondisk mmcblk0 --fstype=ext4 --label user --size 1024
part /userdata --ondisk mmcblk0 --fstype=ext4 --label userdata --size 1024
bootloader --ptable msdos
```
